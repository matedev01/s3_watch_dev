## sdkconfig.defaults
```kconfig
# Target: ESP32-S3 (LilyGO T-RGB 2.1")
CONFIG_IDF_TARGET="esp32s3"

# ---------- Flash ----------
CONFIG_ESPTOOLPY_FLASHSIZE_16MB=y
CONFIG_ESPTOOLPY_FLASHMODE_QIO=y
CONFIG_ESPTOOLPY_FLASHFREQ_80M=y
CONFIG_PARTITION_TABLE_CUSTOM=y
CONFIG_PARTITION_TABLE_CUSTOM_FILENAME="partitions.csv"

# ---------- PSRAM (8 MB OPI on ESP32-S3R8) ----------
CONFIG_SPIRAM=y
CONFIG_SPIRAM_MODE_OCT=y
CONFIG_SPIRAM_TYPE_AUTO=y
CONFIG_SPIRAM_SPEED_80M=y
CONFIG_SPIRAM_FETCH_INSTRUCTIONS=y
CONFIG_SPIRAM_RODATA=y
CONFIG_SPIRAM_USE_MALLOC=y
CONFIG_SPIRAM_MALLOC_ALWAYSINTERNAL=16384
CONFIG_SPIRAM_TRY_ALLOCATE_WIFI_LWIP=y
CONFIG_SPIRAM_BOOT_INIT=y

# ---------- CPU / RTOS ----------
CONFIG_ESP_DEFAULT_CPU_FREQ_MHZ_240=y
CONFIG_FREERTOS_HZ=1000

# ---------- LCD (RGB panel) ----------
# Do NOT enable LCD_RGB_ISR_IRAM_SAFE: esp_lvgl_port's on_vsync handler is not
# in IRAM, and with IRAM_SAFE enabled the panel refuses to register it.

# ---------- Logging / console ----------
CONFIG_LOG_DEFAULT_LEVEL_INFO=y
CONFIG_LOG_COLORS=y
CONFIG_ESP_CONSOLE_USB_SERIAL_JTAG=y

# ---------- LVGL component config ----------
# SKIP=y means "skip loading an external lv_conf.h" -- the lvgl managed component
# then pulls everything from Kconfig via its generated lv_conf_kconfig.h. This is
# what we want; =n would require us to ship our own lv_conf.h on the include path.
CONFIG_LV_CONF_SKIP=y
CONFIG_LV_COLOR_DEPTH_16=y
CONFIG_LV_COLOR_16_SWAP=n

# Use heap_caps/stdlib for LVGL's allocations instead of a large static pool.
CONFIG_LV_MEM_CUSTOM=y
CONFIG_LV_MEMCPY_MEMSET_STD=y

CONFIG_LV_DISP_DEF_REFR_PERIOD=16
CONFIG_LV_INDEV_DEF_READ_PERIOD=16

# Fonts used by the UI
CONFIG_LV_FONT_MONTSERRAT_14=y
CONFIG_LV_FONT_MONTSERRAT_20=y
CONFIG_LV_FONT_MONTSERRAT_28=y
CONFIG_LV_FONT_MONTSERRAT_48=y

# Widget/layout features the UI uses
CONFIG_LV_USE_FLEX=y
CONFIG_LV_USE_GRID=y
CONFIG_LV_USE_BTN=y
CONFIG_LV_USE_LABEL=y
CONFIG_LV_USE_SLIDER=y
```
